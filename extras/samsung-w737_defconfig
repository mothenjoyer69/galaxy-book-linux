## extras/samsung-w737_defconfig
```kconfig
BR2_aarch64=y
BR2_TOOLCHAIN_BUILDROOT_MUSL=y
BR2_BINUTILS_VERSION_2_38_X=y
BR2_GCC_VERSION_11_X=y
BR2_TARGET_GENERIC_HOSTNAME="samsung"
BR2_TARGET_GENERIC_ROOT_PASSWD="root"
BR2_PACKAGE_LM_SENSORS=y
BR2_PACKAGE_NANO=y
BR2_TARGET_ROOTFS_CPIO=y
BR2_TARGET_ROOTFS_CPIO_NONE=y
BR2_TARGET_GRUB2=y
BR2_LINUX_KERNEL=y
BR2_LINUX_KERNEL_CUSTOM_GIT=y
BR2_LINUX_KERNEL_CUSTOM_REPO_URL="https://gitlab.com/sdm845-mainline/linux"
BR2_LINUX_KERNEL_CUSTOM_REPO_VERSION="3c3bb6290821d2feb6adb017227dde0ce773bd16"
BR2_LINUX_KERNEL_USE_ARCH_DEFAULT_CONFIG=y
BR2_LINUX_KERNEL_CONFIG_FRAGMENT_FILES='sdm845.config'
BR2_LINUX_KERNEL_IMAGE=y
BR2_LINUX_KERNEL_GZIP=y
BR2_LINUX_KERNEL_DTS_SUPPORT=y
BR2_LINUX_KERNEL_INTREE_DTS_NAME="qcom/sdm850-samsung-w737"
BR2_PACKAGE_LINUX_TOOLS_CPUPOWER=y
BR2_PACKAGE_LINUX_TOOLS_GPIO=y
BR2_LINUX_KERNEL_INSTALL_TARGET=y
BR2_TARGET_GRUB2_ARM64_EFI=y
```
